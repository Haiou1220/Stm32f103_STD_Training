/**
  ******************************************************************************
 项目介绍：adc1 采集多通道 (使用扫描和 非连续转换，定时器条件触发：软件触发， DMA传输 ) 
             采集  gpio口 电压，并打印
 //PA1---ADC123_IN1/  //PA4---ADC12_IN4/
 
技术概要:
 
注意事项： 
1.DMA 时钟是AHB 需要开启，dma最好自动重载计数
2.adc  最好软件定时器间隔触发转换，不需要频繁转换，以减少DMA完成中断

  ******************************************************************************
  **/

/* Includes ------------------------------------------------------------------*/
#include "main.h"
#include "stm32f10x.h"
#include "stdio.h"
#include "global.h" //公共函数 调试断言
#include "systick.h"//延时定时器 基本延时
#include "timer.h"//定时器2 1ms中断 作为任务定时
#include "usart.h"//串口1 串口助手调试
#include "led.h"//led板载指示灯
#include "adc.h"//adc采集gpio电压




/*Compiler definec : USE_STDPERIPH_DRIVER,STM32F10X_MD */
/* Private typedef -----------------------------------------------------------*/
/* Private define ------------------------------------------------------------*/
/* Private macro -------------------------------------------------------------*/
/* Private function prototypes -----------------------------------------------*/
/* Private functions ---------------------------------------------------------*/
/* Private variables ---------------------------------------------------------*/
 

  
 //------------------------系统全局变量头文件对外声明---------------------------------------- 
//  串口命令任务 ，串口命令 字符标志位
  u8 gFlagUsartCMD_0,gFlagUsartCMD_1,gFlagUsartCMD_2,gFlagUsartCMD_3,gFlagUsartCMD_4,gFlagUsartCMD_5,gFlagUsartCMD_6,gFlagUsartCMD_7,gFlagUsartCMD_8,gFlagUsartCMD_9;
  uint8_t gFlagTime_1MS;// 定时任务标志位
  u8 gDebug_u8;  //调试
  u16 gDebug_u16; //调试 
  

 //------------------------系统全局变量头文件对外声明----------------------------------------
 
 

//--------------------------------------全局静态static变量区 	---------------------------------------------------

 


//--------------------------------------全局静态static变量区 	---------------------------------------------------
	



int main(void)
{
//------------------------主函数局部变量区----------------------  
//定时任务  计时器 标志位
 uint8_t  FlagTime_nMS,FlagTime_500MS,FlagTime_1Sec,FlagTime_3Sec;//系统任务定时
 

 
	
//------------------------主函数局部变量区----------------------
	
	
////////////////////////////   
  NVIC_PriorityGroupConfig(  NVIC_PriorityGroup_2);//配置中断分组2(2bit:2bit)
  sysTick_init();//初始化systick
   usart1_init(115200 ) ;//pa9 tx,  pa10 rx,,,接收中断: 
  timer2_countdown_init();   //配置定时器2为基准的任务计时  
  led_init();//板载led,led0 led1 pb5 pe5
  Led1_Off;	
  Led0_Off;	
/////////////////////
	Info( SYSTEM IS STAR UP); //打印系统启动提示
////////////////////
//------------------------初始化函数区----------------------	

#define FUN_ADC1_MULT_CHANNEL  1

#if( FUN_ADC1_MULT_CHANNEL  )	
	adc1_init( ); //PA1---ADC123_IN1/  //PA4---ADC12_IN4/
#else 
	adc_PA1_init();
#endif


 {	//可变参数打印
u16 static count;	
MyPrintF("my name is %s,my age is %d\r\n","bob",18);
MyPrintF("%d:my name is %s,my age is %d\r\n",count++,"bob",18);
 }
 
	 
//------------------------初始化函数区----------------------	
 while ( 1 ) {
	 
  
	 
	//////////////////////-----------------------串口命令任务---------------------------------------//////////////////
 	if(gFlagUsartCMD_0 == SET)
 	{
		gFlagUsartCMD_0 = RESET;
	////////////////
	 
		printf("adc_get_average_PA1_voltage(5):%f\r\n",adc_get_average_PA1_voltage(5) );
	
		
    ///////////////////////////////////////////////////////////////////////////////////
	}

	if(gFlagUsartCMD_1 == SET)
 	{
		gFlagUsartCMD_1 = RESET;
	/////////////////////////////////////////////////
	 
		extern u16   gADC1_DMA_VAL[2]  ;
		printf("adc1->dr :%f \r\n",   ((     ADC1->DR    )*3.3)/0Xfff   );
        printf("%f,%f \r\n",  ((  gADC1_DMA_VAL[0]     )*3.3)/0Xfff        ,((  gADC1_DMA_VAL[1]     )*3.3)/0Xfff  );
		

	 
	///////////////////////////////////////////////////////////////////////////////////	
	}
	
	if(gFlagUsartCMD_2 == SET)
 	{
		gFlagUsartCMD_2 = RESET;
		//////////////////////////////
 
								
    ///////////////////////////////////////////////////////////////////////////////////
	}

	
	if(gFlagUsartCMD_3 == SET)
	{
		gFlagUsartCMD_3 = RESET;
	 //////

 
		
    //////////////////////////////////////////////////////////////////////////////////////////		
	}
	
	if(gFlagUsartCMD_4 == SET)
	{
		gFlagUsartCMD_4 = RESET;
		//////////////////
	
	 
 
		
		
   ///////////////////////////////////////////////////////////////////////////////////		
	}
	
	if(gFlagUsartCMD_5 == SET) //
	{
		gFlagUsartCMD_5 = RESET;
		/////
	
		
		
	///////////////////////////////////////////////////////////////////////////////////
	}
	
	if(gFlagUsartCMD_6 == SET) //
	{
		gFlagUsartCMD_6 = RESET;
		////
		
 
		
		
	///////////////////////////////////////////////////////////////////////////////////		
	}
	if(gFlagUsartCMD_7 == SET) ////
	{
		gFlagUsartCMD_7 = RESET;
		//////
 
		
///////////////////////////////////////////////////////////////////////////////////			 
	}	
	if(gFlagUsartCMD_8 == SET) //// 
	{
		gFlagUsartCMD_8 = RESET;
		//////
      
		
		
///////////////////////////////////////////////////////////////////////////////////		 
	}
	if(gFlagUsartCMD_9 == SET) 
	{
		gFlagUsartCMD_9 = RESET;
	//////////////////
  
 
	 
////////////////////////////////////////////////////////////////////////////////////////////////	
	}
	
  
	
	
	
/***************************************定时 Nms任务*************************************************************/ 
	if(FlagTime_nMS)
	{
		FlagTime_nMS = RESET;  		////////// Nms
		////////////////
	
	
		
	}
/***************************************定时0.5S 任务*************************************************************/ 	
	////0.5s-任务
	if(FlagTime_500MS)
	{
	FlagTime_500MS = RESET;
		//////////
			
		
	}
/***************************************定时 1S任务*************************************************************/ 
	////1s-任务
	if(FlagTime_1Sec)
	{	
		static uint8_t TIME_COUNT; //默认为0
		FlagTime_1Sec = RESET;
		TIME_COUNT++;
		if(TIME_COUNT % 3 == 2 ){  FlagTime_3Sec = SET;  }   //余 0 1 2
		if(TIME_COUNT>=255) { TIME_COUNT = 0; }
		////////////////////////////////////////////////////
		
 
		
     adc1_SoftwareStartConv() ; //adc1软件触发 使能，转换开始后硬件马上清除此位。
		
		
		
 /***************************************定时 3S任务*************************************************************/ 		
	}	
	////3s-任务
	if(FlagTime_3Sec)
	{
		FlagTime_3Sec = RESET;
		/////////////////////////////////////////////////
 
	   
	}
	 
/***************************************定时 任务*************************************************************/ 	
	//定时器2计数任务
	if( gFlagTime_1MS == SET ) 
	{	
		static uint16_t count1000,countN,count500; //局部静态默认为0
		gFlagTime_1MS = RESET;
		count1000++;
		countN++;
		count500++;
		if(countN>=   1  )  //自定义 ms
		{
			countN = 0;
			FlagTime_nMS = SET;
		}
		if(count500>=500)  //0.5S任务标志位
		{
			count500 = 0;
			FlagTime_500MS = SET;
		}
		if(count1000>=1000)  ////1S任务标志位，，，闭区间0................1000开区间
		{
			count1000 = 0;
			FlagTime_1Sec = SET;
		}
	 }
	
	 

 }//WHILE
}//MAIN




