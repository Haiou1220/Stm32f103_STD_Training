/********************************************************************************
 项目介绍： OLED 0.96寸 驱动 //无  DMA 
 
技术概要:OLED 0.96寸 驱动 //无  DMA ，PCtoLCD2002 英文取模：逐列式+顺向，中文取模：行列式 逆向(低位在前)，
 
注意事项： //12*12 ASCII字符集点阵,宋体,阴码+逐列式+顺向+C51格式
SSD1306的写入方向，决定字体取模方式
 

  ********************************************************************************/

/* Includes ------------------------------------------------------------------*/
#include "main.h"//main头文件
#include "stm32f10x.h" //标准库头文件
#include "stdio.h"     //标准输入输出头文件
#include "global.h" //公共函数 调试与断言
#include "systick.h"//延时定时器 基本延时
#include "timer.h"//定时器2 1ms中断 作为任务定时
#include "usart.h"//串口1 串口助手调试
#include "led.h"//led板载指示灯
 #include "iic_soft.h" //i2c1
 #include "ssd1306.h"
 #include "stdio.h"


/*Compiler definec : USE_STDPERIPH_DRIVER,STM32F10X_MD */
/* Private typedef -----------------------------------------------------------*/
/* Private define ------------------------------------------------------------*/
/* Private macro -------------------------------------------------------------*/
/* Private function prototypes -----------------------------------------------*/
/* Private functions ---------------------------------------------------------*/
/* Private variables ---------------------------------------------------------*/
 

  
 //------------------------系统全局变量头文件对外声明---------------------------------------- 
//  串口命令任务 ，串口命令 字符标志位
  u8 gFlagUsartCMD_0,gFlagUsartCMD_1,gFlagUsartCMD_2,gFlagUsartCMD_3,gFlagUsartCMD_4,gFlagUsartCMD_5,gFlagUsartCMD_6,gFlagUsartCMD_7,gFlagUsartCMD_8,gFlagUsartCMD_9;
  uint8_t gFlagTime_1MS;// 定时任务标志位
  u8 gDebug_u8;  //调试
  u16 gDebug_u16; //调试 
  

 //------------------------系统全局变量头文件对外声明----------------------------------------
 
 

//--------------------------------------全局静态static变量区 	---------------------------------------------------

 


//--------------------------------------全局静态static变量区 	---------------------------------------------------
	



int main(void)
{
//------------------------主函数局部变量区----------------------  
//定时任务  计时器 标志位
 uint8_t  FlagTime_nMS,FlagTime_500MS,FlagTime_1Sec,FlagTime_3Sec;//系统任务定时
 

 
	
//------------------------主函数局部变量区----------------------
	
	
//------------------------板载系统硬件初始化----------------------	 
  NVIC_PriorityGroupConfig(  NVIC_PriorityGroup_2);//配置中断分组2(2bit:2bit)
  sysTick_init();//初始化systick
   usart1_init(115200 ) ;//pa9 tx,  pa10 rx,,,接收中断: 
  timer2_countdown_init();   //配置定时器2为基准的任务计时  
  led_init();//板载led,led0 led1 pb5 pe5
  Led1_Off;	
  Led0_Off;	
/////////////////////
	Info( SYSTEM IS STAR UP); //打印系统启动提示
////////////////////
//------------------------初始化函数区----------------------	



 {	//可变参数打印
u16 static count;	
	 MyPrintF("welcome home: %s\r\n","haiou");
	 MyPrintF("home temperature:%d\r\n",count++);
 }
 
     ssd1306_init();
 		 
	 
//------------------------初始化函数区----------------------	
 while ( 1 ) {
	 

	 
///////////////////////////////////-----------------------串口命令任务---------------------------------------//////////////////
 	if(gFlagUsartCMD_0 == SET)
 	{	gFlagUsartCMD_0 = RESET;
///////////////////////////////////////////////////////////////////////////////////////////
	 
	
		uint8_t a[] = "ABCDEFGHIJKLMN";
		
		
		OLED_ShowString(0,12*0, a ,  12 );
			

		
////////////////////////////////////////////////////////////////////////////////////////////////////////////
	}
	if(gFlagUsartCMD_1 == SET)
 	{	gFlagUsartCMD_1 = RESET;
////////////////////////////////////////////////////////////////////////////////////////////////////
	 
 
		  OLED_ShowChar(6*2,0,'B',  12,  1);
  	
	 
////////////////////////////////////////////////////////////////////////////////////////////	
	}
	if(gFlagUsartCMD_2 == SET)
 	{	gFlagUsartCMD_2 = RESET;
////////////////////////////////////////////////////////////////////////////////
	
				
		  OLED_ShowNum(12*0,12*1,19921220, 8,  12);	

		
////////////////////////////////////////////////////////////////////////////////////////////
	}
	if(gFlagUsartCMD_3 == SET)
	{	gFlagUsartCMD_3 = RESET;
////////////////////////////////////////////////////////////////////

	   OLED_Fill( 0, 0, 12*3, 12*3,  1);	
		
/////////////////////////////////////////////////////////////////////////////////////////////////////		
	}
	if(gFlagUsartCMD_4 == SET)
	{	gFlagUsartCMD_4 = RESET;
//////////////////////////////////////////////////////////////////////
			
		
//////////////////////////////////////////////////////////////////////////////////////////////		
	}
	if(gFlagUsartCMD_5 == SET) //
	{	gFlagUsartCMD_5 = RESET;
//////////////////////////////////////////////////////////////////////////////////
	
		
	
		
		
////////////////////////////////////////////////////////////////////////////////////////////////
	}
	if(gFlagUsartCMD_6 == SET) //
	{	gFlagUsartCMD_6 = RESET;
////////////////////////////////////////////////////////////////////
		
 
		
////////////////////////////////////////////////////////////////////////////////////////////////		
	}
	if(gFlagUsartCMD_7 == SET) ////
	{	gFlagUsartCMD_7 = RESET;
//////////////////////////////////////////////////////////
 
	
		
		
///////////////////////////////////////////////////////////////////////////////////			 
	}	
	if(gFlagUsartCMD_8 == SET) //// 
	{	gFlagUsartCMD_8 = RESET;
///////////////////////////////////////////////////////////////////////////////////

  OLED_Clear( );  
		
///////////////////////////////////////////////////////////////////////////////////		 
	}
	if(gFlagUsartCMD_9 == SET) 
	{	gFlagUsartCMD_9 = RESET;
//////////////////////////////////////////////////////////////////////
  

 //OLED_ShowChar(16*0,16*0,zh_font_1616[0][0],  16,  1);
		 
    OLED_ShowChinese_det(0*16,0*16,0, 16);
		
		 OLED_ShowChinese_det(1*16,0*16,1, 16);
 		
		  OLED_ShowChinese_det(2*16,0*16,2, 16);
		
		
	    OLED_ShowChinese_det(0*24+3*16,0*24,0, 24);
		OLED_ShowChinese_det(1*24+3*16,0*24,1, 24);
		OLED_ShowChinese_det(2*24+3*16,0*24,2, 24);
		
////////////////////////////////////////////////////////////////////////////////////////////////	
	}///////////////////////////////////////////////////////////////////////////////////////////
	
/***************************************定时 Nms任务*************************************************************/ 
	if(FlagTime_nMS)      //// Nms
	{	FlagTime_nMS = RESET;  
/////////////////////////////////////////////////////////////////////////////////////////////////////////////
	
		
		
		

		
	
/***************************************定时0.5S 任务*************************************************************/ 	
	}////0.5s-任务
	if(FlagTime_500MS)
	{	FlagTime_500MS = RESET;
///////////////////////////////////////////////////////////////////////////////////////////////////////
			
	
 
		
	
/***************************************定时 1S任务*************************************************************/ 
	}////1s-任务
	if(FlagTime_1Sec)
	{	static uint8_t TIME_COUNT; //默认为0
		FlagTime_1Sec = RESET;
		TIME_COUNT++;
		if(TIME_COUNT % 3 == 2 ){  FlagTime_3Sec = SET;  }   //余 0 1 2
		if(TIME_COUNT>=255) { TIME_COUNT = 0; }
/////////////////////////////////////////////////////////////////////////////////////////////////////
		
 
	 
		OLED_Refresh_Gram( );

 

		static uint16_t hour = 0,min = 0,sec = 0;	
		 static char buf[128];//128列
		sec++;
		if(sec>=60)
		{
		sec = 0;
		min++;
		}
		if(min>=60)
		{
		min = 0;
		hour++;
		}
		if(hour>=24)
		{
		hour = 0;
		}
		
		snprintf (buf,(sizeof(buf)/sizeof(char)),"%02d:%02d:%02d",hour,min,sec);
		
		OLED_ShowString(0,16*3, (uint8_t*)buf ,  16 );	





 
		
 /***************************************定时 3S任务*************************************************************/ 		
	}////3s-任务
	if(FlagTime_3Sec)
	{ FlagTime_3Sec = RESET;
/////////////////////////////////////////////////////////////////////////////////////////
 
	
		
/*******************************************************************************************************/ 	   
	}//定时器2计数任务
	if( gFlagTime_1MS == SET ) 
	{	
		static uint16_t count1000,countN,count500; //局部静态默认为0
		gFlagTime_1MS = RESET;
		count1000++;
		countN++;
		count500++;
		if(countN>=   1  )  //自定义 ms
		{
			countN = 0;
			FlagTime_nMS = SET;
		}
		if(count500>=500)  //0.5S任务标志位
		{
			count500 = 0;
			FlagTime_500MS = SET;
		}
		if(count1000>=1000)  ////1S任务标志位，，，闭区间0................1000开区间
		{
			count1000 = 0;
			FlagTime_1Sec = SET;
		}
	 }
/***************************************************************************************************/ 
 }//WHILE
}//MAIN




