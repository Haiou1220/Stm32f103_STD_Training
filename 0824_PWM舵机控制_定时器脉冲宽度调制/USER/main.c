/**
  ******************************************************************************
 
 项目介绍：pwm实现舵机SG90 默认角度复位90度，在指定0-180角度快速定位，用50ms 定时刷新舵机角度的pwm比较值
控制脉冲一直维持，以保证有维持的力矩输出，及时修正外力的影响。					 
串口发送0命令，减少角度值，命令1，增加角度值					

  
   
  sg90 现象：1.如果在20ms周期下,高电平时间大于2.4ms 舵机堵转，与理论有偏差，经过测试 最小25->0.5ms      最大122->2.44ms
			2.如果需要舵机维持固定角度的力量，脉冲信号不可以撤销
			3.没必要一直刷新舵机的比较值，也不要1s才刷新反应太慢，合理应该50ms 刷新一次
  
 技术实现：1.根据 SG90资料可知 它内部有一个基准电路，产生周期为 20ms，宽度为 1.5ms 的基准信号
  1.5ms的高电平时间表示旋转角度为0。
  2. 信号要求：20ms 周期 ，高电平范围 0.5ms-2.5ms，     1.5加减1ms   0度加减90度
  定时器5配置pwm，时基单元配置， 20MS = 50 hz,72M hz/1440K hz = 50hz,,,,,,,,需要1440K分频->1000*1440
 Prescaler = 1440-1;Period = 1000-1;
  
  ******************************************************************************
  */

/* Includes ------------------------------------------------------------------*/
#include "main.h"
#include "stm32f10x.h"
#include "stdio.h"
#include "global.h"
#include "systick.h"//延时定时器
#include "timer.h"//定时器2 1ms中断 作为任务定时
#include "usart.h"//串口1 串口助手
#include "led.h"
#include "dma_usart.h"  //串口1dma
#include "pwm_servo.h"  //串口1dma



/*Compiler definec : USE_STDPERIPH_DRIVER,STM32F10X_MD */
/* Private typedef -----------------------------------------------------------*/
/* Private define ------------------------------------------------------------*/
/* Private macro -------------------------------------------------------------*/




/* Private function prototypes -----------------------------------------------*/
/* Private functions ---------------------------------------------------------*/
/* Private variables ---------------------------------------------------------*/
 

  
 //------------------------系统全局变量头文件对外声明---------------------------------------- 
//  串口命令任务 ，串口命令 字符标志位
 u8 gFlagUsartCMD_0,gFlagUsartCMD_1,gFlagUsartCMD_2,gFlagUsartCMD_3,gFlagUsartCMD_4,gFlagUsartCMD_5,gFlagUsartCMD_6,gFlagUsartCMD_7,gFlagUsartCMD_8,gFlagUsartCMD_9;
   // 定时任务标志位
  uint8_t gFlagTime_1MS;
  
  u8 gDebug_u8;  //调试
  u16 gDebug_u16; //调试 
 //------------------------系统全局变量头文件对外声明----------------------------------------
 
 

//--------------------------------------全局静态static变量区 	---------------------------------------------------

 


//--------------------------------------全局静态static变量区 	---------------------------------------------------
	



int main(void)
{
//------------------------主函数局部变量区----------------------  
//定时任务  计时器 标志位
 uint8_t  FlagTime_nMS,FlagTime_500MS,FlagTime_1Sec,FlagTime_3Sec;
  // s8 Light_per = 0; //ws2812 的亮度百分百0-100
 
s16 Servo_setAngle = 90;
 
	
//------------------------主函数局部变量区----------------------
	
	
 

////////////////////////////   
  NVIC_PriorityGroupConfig(  NVIC_PriorityGroup_2);//配置中断分组2(2bit:2bit)
  sysTick_init();//初始化systick
  usart1_init(115200 ) ;//pa9 tx,  pa10 rx
  timer2_countdown_init();   //配置定时器2计时中断
  Led1_Off;	
  Led0_Off;	
/////////////////////
	Info( MAIN FUN STAR UP); //打印系统启动提示
////////////////////
//------------------------启动函数区----------------------	
	  Servo_tim5ch2pa1_init( ) ;//
	
 


 //Servo_tim5ch2pa1_setAngle(  90); //20ms 周期正确，，

	

//------------------------启动函数区----------------------	
 while ( 1 ) {
	 
  
	
	 
	//////////////////////-----------------------串口命令任务---------------------------------------//////////////////
 	if(gFlagUsartCMD_0 == SET)
 	{
		gFlagUsartCMD_0 = RESET;
	////////////////
	 
		Servo_setAngle--;
		if(Servo_setAngle < 0) Servo_setAngle = 0;
		printf("-Servo_setAngle:%d\r\n",Servo_setAngle);
		
    ///////////////////////////////////////////////////////////////////////////////////
	}

	if(gFlagUsartCMD_1 == SET)
 	{
		gFlagUsartCMD_1 = RESET;
	/////////////////////////////////////////////////
		
		
	 
		Servo_setAngle++;
		if(Servo_setAngle > 180) Servo_setAngle =180;
		printf("+Servo_setAngle:%d\r\n",Servo_setAngle);

	///////////////////////////////////////////////////////////////////////////////////	
	}
	
	if(gFlagUsartCMD_2 == SET)
 	{
		gFlagUsartCMD_2 = RESET;
		//////////////////////////////
			 
								 
    ///////////////////////////////////////////////////////////////////////////////////
	}

	
	if(gFlagUsartCMD_3 == SET)
	{
		gFlagUsartCMD_3 = RESET;
	 //////


	
		
		
		
 
		
		
		
    //////////////////////////////////////////////////////////////////////////////////////////		
	}
	
	if(gFlagUsartCMD_4 == SET)
	{
		gFlagUsartCMD_4 = RESET;
		//////////////////
	
	 
		
   ///////////////////////////////////////////////////////////////////////////////////		
	}
	
	if(gFlagUsartCMD_5 == SET) //
	{
		gFlagUsartCMD_5 = RESET;
		/////
	
		
		
	///////////////////////////////////////////////////////////////////////////////////
	}
	
	if(gFlagUsartCMD_6 == SET) //
	{
		gFlagUsartCMD_6 = RESET;
		////
		
		
		
		
		
		
	///////////////////////////////////////////////////////////////////////////////////		
	}
	if(gFlagUsartCMD_7 == SET) ////
	{
		gFlagUsartCMD_7 = RESET;
		//////
 
		
///////////////////////////////////////////////////////////////////////////////////			 
	}	
	if(gFlagUsartCMD_8 == SET) //// 
	{
		gFlagUsartCMD_8 = RESET;
		//////
		
		
		
		
///////////////////////////////////////////////////////////////////////////////////		 
	}
	if(gFlagUsartCMD_9 == SET) 
	{
		gFlagUsartCMD_9 = RESET;
	//////////////////
    		


		
		
	 
////////////////////////////////////////////////////////////////////////////////////////////////	
	}
	
  
	
	
	
	
	
/***************************************定时 Nms任务*************************************************************/ 
	if(FlagTime_nMS)
	{
		FlagTime_nMS = RESET;  		////////// Nms
		////////////////
		//50ms
		    
		
		
	
						  Servo_tim5ch2pa1_setAngle( Servo_setAngle) ;
		
		
		
		
	}
/***************************************定时0.5S 任务*************************************************************/ 	
	////0.5s-任务
	if(FlagTime_500MS)
	{
	FlagTime_500MS = RESET;
		//////////
	
	
	}
/***************************************定时 1S任务*************************************************************/ 
	////1s-任务
	if(FlagTime_1Sec)
	{	
		static uint8_t data_count; //默认为0
		FlagTime_1Sec = RESET;
		data_count++;
		if(data_count % 3 == 2 ){  FlagTime_3Sec = SET;  }   //余 0 1 2
		if(data_count>=255) { data_count = 0; }
		////////////////////////////////////////////////////
		

		
		
		
		
		
 /***************************************定时 3S任务*************************************************************/ 		
	}	
	////3s-任务
	if(FlagTime_3Sec)
	{
		FlagTime_3Sec = RESET;
		/////////////////////////////////////////////////
 
	     
	}
	 
/***************************************定时 任务*************************************************************/ 	
	//定时器2计数任务
	if( gFlagTime_1MS == SET ) 
	{	
		static uint16_t count1000,countN,count500; //局部静态默认为0
		gFlagTime_1MS = RESET;
		count1000++;
		countN++;
		count500++;
		if(countN>=   50  )  //自定义 ms
		{
			countN = 0;
			FlagTime_nMS = SET;
		}
		if(count500>=500)  //0.5S任务标志位
		{
			count500 = 0;
			FlagTime_500MS = SET;
		}
		if(count1000>=1000)  ////1S任务标志位，，，闭区间0................1000开区间
		{
			count1000 = 0;
			FlagTime_1Sec = SET;
		}
	 }
	
 
 
	 

 }//WHILE
}//MAIN




